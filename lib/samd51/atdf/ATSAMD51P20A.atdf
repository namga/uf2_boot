# ATSAMD51P20A device description
Architecture: CORTEX-M4; Family: SAMD; Series: SAMD51
Parameters: GCLK_ID_TRACE=47, LITTLE_ENDIAN=1, NUM_IRQ=137, __CM4_REV=0x0001, __DEBUG_LVL=3, __FPU_PRESENT=1, __MPU_PRESENT=1, __NVIC_PRIO_BITS=3, __TRACE_LVL=2, __VTOR_PRESENT=1, __Vendor_SysTickConfig=0
Programming and debug interfaces: SWD
Registers are 32-bit, read-write, reset 0x0 unless marked. A register's access mark holds for its fields unless they carry their own. Offsets are from the block's base; lines under a group give offsets from that group; [hi:lo] are bit positions; {n}, {i} and the like mark numbered series; 'fields as' and 'values as' point back to an identical list; <NAME> marks a mode.

## Ordering variants
SAMD51P20A-AU: TQFP128, pinout SAMD51P, up to 150 MHz, -40 to 85 C, 1.71 to 3.60 V
SAMD51P20A-AF: TQFP128, pinout SAMD51P, up to 150 MHz, -40 to 125 C, 1.71 to 3.60 V

## Memory
base space: start 0 size 0x100000000, little endian
  0x03000000 CMCC size 0x1000000 io, rw
  0x3000000 CMCC_DATARAM size 0x1000 io, rw
  0x3001000 CMCC_TAGRAM size 0x400 io, rw
  0x3002000 CMCC_VALIDRAM size 0x40 io, rw
  0x20000000 HSRAM size 0x40000 ram, rw, executable
  0x20000000 HSRAM_ETB size 0x8000 ram, rw, executable
  0x20000000 HSRAM_RET1 size 0x8000 ram, rw, executable
  0x40000000 HPB0 size 0x4400 io, rw
  0x41000000 HPB1 size 0x22000 io, rw
  0x42000000 HPB2 size 0x3C00 io, rw
  0x43000000 HPB3 size 0x3000 io, rw
  0x00000000 FLASH size 0x100000 flash, rw, executable, page 512
  0x00804000 AUX0 size 0x200 user_page, rw, page 16
  0x44000000 SEEPROM size 0x20000 io, rw
  0x47000000 BKUPRAM size 0x2000 ram, rw, executable
  0xE0000000 PPB size 0x100000 io, rw
  0x04000000 QSPI size 0x1000000 other, rw, executable, external
  0x45000000 SDHC0 size 0xC00 io, rw
  0x46000000 SDHC1 size 0xC00 io, rw
  0xE000E000 SCS size 0x00001000 io, rw
fuses space: start 0x00000000 size 0x10000, little endian

## Peripheral instances (address, pins/pin function, parameters)
AC at 0x42002000
  pins: AIN0 PA04/B_AC; AIN1 PA05/B_AC; AIN2 PA06/B_AC; AIN3 PA07/B_AC; CMP0 PA12/M or PA18/M or PB24/M; CMP1 PA13/M or PA19/M or PB25/M
  parameters: COMPCTRL_MUXNEG_OPAMP=7, GCLK_ID=32, IMPLEMENTS_VDBLR=0, NUM_CMP=2, PAIRS=1, SPEED_LEVELS=2, INSTANCE_ID=72
ADC0 at 0x43001C00 (ADC)
  pins: AIN0 PA02/B_ADC0; AIN1 PA03/B_ADC0; AIN2 PB08/B_ADC0; AIN3 PB09/B_ADC0; AIN{n} PA{n:02}/B_ADC0 (n=4..11); AIN12 PB00/B_ADC0; AIN13 PB01/B_ADC0; AIN14 PB02/B_ADC0; AIN15 PB03/B_ADC0; DRV0 PA03/O_PTC_DRV; DRV1 PB08/O_PTC_DRV; DRV2 PB09/O_PTC_DRV; DRV3 PA04/O_PTC_DRV; DRV4 PA06/O_PTC_DRV; DRV5 PA07/O_PTC_DRV; DRV6 PA08/O_PTC_DRV; DRV7 PA09/O_PTC_DRV; DRV8 PA10/O_PTC_DRV; DRV9 PA11/O_PTC_DRV; DRV{n} PA{n+6}/O_PTC_DRV (n=10..17); DRV18 PA27/O_PTC_DRV; DRV19 PA30/O_PTC_DRV; DRV20 PB02/O_PTC_DRV; DRV21 PB03/O_PTC_DRV; DRV22 PB04/O_PTC_DRV; DRV23 PB05/O_PTC_DRV; DRV24 PB06/O_PTC_DRV; DRV25 PB07/O_PTC_DRV; DRV26 PB12/O_PTC_DRV; DRV27 PB13/O_PTC_DRV; DRV28 PB14/O_PTC_DRV; DRV29 PB15/O_PTC_DRV; DRV30 PB00/O_PTC_DRV; DRV31 PB01/O_PTC_DRV; X0 PA03/B_PTC; Y0 PA03/B_PTC; X1 PB08/B_PTC; Y1 PB08/B_PTC; X2 PB09/B_PTC; Y2 PB09/B_PTC; X3 PA04/B_PTC; Y3 PA04/B_PTC; X4 PA06/B_PTC; Y4 PA06/B_PTC; X5 PA07/B_PTC; Y5 PA07/B_PTC; X6 PA08/B_PTC; Y6 PA08/B_PTC; X7 PA09/B_PTC; Y7 PA09/B_PTC; X8 PA10/B_PTC; Y8 PA10/B_PTC; X9 PA11/B_PTC; Y9 PA11/B_PTC; X10 PA16/B_PTC; Y10 PA16/B_PTC; X11 PA17/B_PTC; Y11 PA17/B_PTC; X13 PA19/B_PTC; Y13 PA19/B_PTC; X14 PA20/B_PTC; Y14 PA20/B_PTC; X15 PA21/B_PTC; Y15 PA21/B_PTC; X16 PA22/B_PTC; Y16 PA22/B_PTC; X17 PA23/B_PTC; Y17 PA23/B_PTC; X18 PA27/B_PTC; Y18 PA27/B_PTC; X19 PA30/B_PTC; Y19 PA30/B_PTC; X20 PB02/B_PTC; Y20 PB02/B_PTC; X21 PB03/B_PTC; Y21 PB03/B_PTC; X22 PB04/B_PTC; Y22 PB04/B_PTC; X23 PB05/B_PTC; Y23 PB05/B_PTC; X24 PB06/B_PTC; Y24 PB06/B_PTC; X25 PB07/B_PTC; Y25 PB07/B_PTC; X26 PB12/B_PTC; Y26 PB12/B_PTC; X27 PB13/B_PTC; Y27 PB13/B_PTC; X28 PB14/B_PTC; Y28 PB14/B_PTC; X29 PB15/B_PTC; Y29 PB15/B_PTC; X30 PB00/B_PTC; Y30 PB00/B_PTC; X31 PB01/B_PTC; Y31 PB01/B_PTC
  parameters: BANDGAP=27, CTAT=29, DMAC_ID_RESRDY=68, DMAC_ID_SEQ=69, EXTCHANNEL_MSB=15, GCLK_ID=40, MASTER_SLAVE_MODE=1, OPAMP2=0, OPAMP01=0, PTAT=28, TOUCH_IMPLEMENTED=1, TOUCH_LINES_NUM=32, INSTANCE_ID=103
ADC1 at 0x43002000 (ADC)
  pins: AIN0 PB08/B_ADC1; AIN1 PB09/B_ADC1; AIN2 PA08/B_ADC1; AIN3 PA09/B_ADC1; AIN4 PC02/B_ADC1; AIN5 PC03/B_ADC1; AIN6 PB04/B_ADC1; AIN7 PB05/B_ADC1; AIN8 PB06/B_ADC1; AIN9 PB07/B_ADC1; AIN10 PC00/B_ADC1; AIN11 PC01/B_ADC1; AIN12 PC30/B_ADC1; AIN13 PC31/B_ADC1; AIN14 PD00/B_ADC1; AIN15 PD01/B_ADC1
  parameters: BANDGAP=27, CTAT=29, DMAC_ID_RESRDY=70, DMAC_ID_SEQ=71, EXTCHANNEL_MSB=15, GCLK_ID=41, MASTER_SLAVE_MODE=2, OPAMP2=0, OPAMP01=0, PTAT=28, TOUCH_IMPLEMENTED=0, TOUCH_LINES_NUM=1, INSTANCE_ID=104
AES at 0x42002400
  parameters: DMAC_ID_RD=82, DMAC_ID_WR=81, FOUR_BYTE_OPERATION=1, GCM=1, KEYLEN=2, INSTANCE_ID=73
CCL at 0x42003800
  pins: IN0 PA04/N or PA16/N or PB22/N; IN1 PA05/N or PA17/N or PB00/N; IN2 PA06/N or PA18/N or PB01/N; IN3 PA08/N or PA30/N; IN4 PA09/N or PC27/N; IN5 PA10/N or PC28/N; IN6 PA22/N or PB06/N; IN7 PA23/N or PB07/N; IN8 PA24/N or PB08/N; IN9 PB14/N or PC20/N; IN10 PB15/N or PC21/N; IN11 PB10/N or PB16/N; OUT0 PA07/N or PA19/N or PB02/N or PB23/N; OUT1 PA11/N or PA31/N or PB11/N; OUT2 PA25/N or PB09/N; OUT3 PB17/N
  parameters: GCLK_ID=33, LUT_NUM=4, SEQ_NUM=2, INSTANCE_ID=78
CMCC at 0x41006000
  parameters: INSTANCE_ID=35
DAC at 0x43002400
  pins: VOUT0 PA02/B_DAC; VOUT1 PA05/B_DAC
  parameters: CHANNEL_SIZE=2, DATA_SIZE=12, GCLK_ID=42, STEP=7, INSTANCE_ID=105
DMAC at 0x4100A000
  parameters: BURST=1, CH_BITS=5, CH_NUM=32, EVIN_NUM=8, EVOUT_NUM=4, FIFO_SIZE=16, LVL_BITS=2, LVL_NUM=4, QOSCTRL_D_RESETVALUE=2, QOSCTRL_F_RESETVALUE=2, QOSCTRL_WRB_RESETVALUE=2, TRIG_BITS=7, TRIG_NUM=85, INSTANCE_ID=37
DSU at 0x41002000
  parameters: DMAC_ID_DCC0=2, DMAC_ID_DCC1=3, INSTANCE_ID=33
EIC at 0x40002800
  pins: EXTINT0 PA00/A or PA16/A or PB00/A or PB16/A or PC00/A or PC16/A or PD00/A; EXTINT1 PA01/A or PA17/A or PB01/A or PB17/A or PC01/A or PC17/A or PD01/A; EXTINT2 PA02/A or PA18/A or PB02/A or PB18/A or PC02/A or PC18/A; EXTINT3 PA03/A or PA19/A or PB03/A or PB19/A or PC03/A or PC19/A or PD08/A; EXTINT4 PA04/A or PA20/A or PB04/A or PB20/A or PC04/A or PC20/A or PD09/A; EXTINT5 PA05/A or PA21/A or PB05/A or PB21/A or PC05/A or PC21/A or PD10/A; EXTINT6 PA06/A or PA22/A or PB06/A or PB22/A or PC06/A or PC22/A or PD11/A; EXTINT7 PA07/A or PA23/A or PB07/A or PB23/A or PC23/A or PD12/A; EXTINT8 PA24/A or PB08/A or PB24/A or PC24/A; EXTINT9 PA09/A or PA25/A or PB09/A or PB25/A or PC07/A or PC25/A; EXTINT10 PA10/A or PB10/A or PC10/A or PC26/A or PD20/A; EXTINT11 PA11/A or PA27/A or PB11/A or PC11/A or PC27/A or PD21/A; EXTINT12 PA12/A or PB12/A or PB26/A or PC12/A or PC28/A; EXTINT13 PA13/A or PB13/A or PB27/A or PC13/A; EXTINT14 PA30/A or PB14/A or PB28/A or PB30/A or PC14/A or PC30/A or PA14/A; EXTINT15 PA15/A or PA31/A or PB15/A or PB29/A or PB31/A or PC15/A or PC31/A; NMI PA08/A
  parameters: EXTINT_NUM=16, GCLK_ID=4, NUMBER_OF_CONFIG_REGS=2, NUMBER_OF_DPRESCALER_REGS=2, NUMBER_OF_INTERRUPTS=16, INSTANCE_ID=10
EVSYS at 0x4100E000
  parameters: ASYNCHRONOUS_CHANNELS=0xFFFFF000, CHANNELS=32, CHANNELS_BITS=5, EXTEVT_NUM=0, GENERATORS=119, GENERATORS_BITS=7, SYNCH_NUM=12, SYNCH_NUM_BITS=4, USERS=67, USERS_BITS=7, INSTANCE_ID=39
FREQM at 0x40002C00
  parameters: GCLK_ID_MSR=5, INSTANCE_ID=11
GCLK at 0x40001C00
  pins: IO0 PA30/M or PB14/M or PA14/M or PB22/M; IO1 PB15/M or PA15/M or PB23/M or PA27/M; IO2 PA16/M or PB16/M; IO3 PA17/M or PB17/M; IO4 PA10/M or PB10/M or PB18/M; IO5 PA11/M or PB11/M or PB19/M; IO6 PB12/M or PB20/M; IO7 PB13/M or PB21/M
  parameters: GENCTRL0_RESETVALUE=106, GENDIV_BITS=16, GEN_BITS=4, GEN_NUM=12, GEN_NUM_MSB=11, GEN_SOURCE_NUM_MSB=8, IO_NUM=8, NUM=48, SOURCE_BITS=4, SOURCE_NUM=9, INSTANCE_ID=7
HMATRIX at 0x4100C000 (HMATRIXB)
  parameters: MASTER_NUM=8, MASTER_CM4_S=0, MASTER_CMCC=1, MASTER_PICOP_MEM=2, MASTER_PICOP_IO=3, MASTER_DMAC_DTWR=4, MASTER_DMAC_DTRD=5, MASTER_ICM=6, MASTER_DSU=7, SLAVE_NUM=15, SLAVE_FLASH=0, SLAVE_FLASH_ALT=1, SLAVE_SEEPROM=2, SLAVE_RAMCM4S=3, SLAVE_RAMPPPDSU=4, SLAVE_RAMDMAWR=5, SLAVE_RAMDMACICM=6, SLAVE_HPB0=7, SLAVE_HPB1=8, SLAVE_HPB2=9, SLAVE_HPB3=10, SLAVE_SDHC0=12, SLAVE_SDHC1=13, SLAVE_QSPI=14, SLAVE_BKUPRAM=15, INSTANCE_ID=38
ICM at 0x42002C00
  parameters: INSTANCE_ID=75
I2S at 0x43002800
  pins: FS0 PA09/J or PA20/J; FS1 PA23/J or PB11/J; MCK0 PA08/J or PB17/J; MCK1 PB29/J or PB13/J; SCK0 PA10/J or PB16/J; SCK1 PB28/J or PB12/J; SDI PA22/J or PB10/J; SDO PA11/J or PA21/J
  parameters: CLK_NUM=2, MAX_SLOTS=8, MAX_WL_BITS=32, SER_NUM=2, INSTANCE_ID=106
MCLK at 0x40000800
  parameters: SYSTEM_CLOCK=48000000, INSTANCE_ID=2
  clocks: AHB HPB0 bit 0, HPB1 bit 1, HPB2 bit 2, HPB3 bit 3, DSU bit 4, HMATRIX bit 5, NVMCTRL bit 6, HSRAM bit 7, CMCC bit 8, DMAC bit 9, USB bit 10, BKUPRAM bit 11, PAC bit 12, QSPI bit 13, SDHC0 bit 15, SDHC1 bit 16, ICM bit 19, PUKCC bit 20, QSPI_2X bit 21, NVMCTRL_SMEEPROM bit 22, NVMCTRL_CACHE bit 23
NVMCTRL at 0x41004000
  parameters: BLOCK_SIZE=8192, FLASH_SIZE=1048576, PAGES=2048, PAGES_PR_REGION=128, PSM_0_FRMFW_FWS_1_MAX_FREQ=12000000, PSM_0_FRMLP_FWS_0_MAX_FREQ=18000000, PSM_0_FRMLP_FWS_1_MAX_FREQ=36000000, PSM_0_FRMHS_FWS_0_MAX_FREQ=25000000, PSM_0_FRMHS_FWS_1_MAX_FREQ=50000000, PSM_1_FRMFW_FWS_1_MAX_FREQ=12000000, PSM_1_FRMLP_FWS_0_MAX_FREQ=8000000, PSM_1_FRMLP_FWS_1_MAX_FREQ=12000000, INSTANCE_ID=34
FUSES at SW0_FUSES 0x00800080 in fuses, TEMP_LOG_FUSES 0x00800100 in fuses, USER_FUSES 0x00804000 in fuses
OSCCTRL at 0x40001000
  pins: XIN0 PA14/XIN0; XIN1 PB22/XIN1; XOUT0 PA15/XOUT0; XOUT1 PB23/XOUT1
  parameters: DFLLS_NUM=1, DFLL_IMPLEMENTED=1, DFLL48M_BIASTESTPT_IMPLEMENTED=0, DFLL48M_CDACSTEPSIZE_SIZE=2, DFLL48M_COARSE_RESET_VALUE=32, DFLL48M_COARSE_SIZE=6, DFLL48M_ENABLE_RESET_VALUE=1, DFLL48M_FDACSTEPSIZE_SIZE=2, DFLL48M_FINE_RESET_VALUE=128, DFLL48M_FINE_SIZE=8, DFLL48M_ONDEMAND_RESET_VALUE=1, DFLL48M_RUNSTDBY_RESET_VALUE=0, DFLL48M_TCAL_SIZE=4, DFLL48M_TCBIAS_SIZE=2, DFLL48M_TESTPTSEL_SIZE=3, DFLL48M_WAITLOCK_ACTIVE=1, DPLLS_NUM=2, DPLL0_IMPLEMENTED=1, DPLL0_I12ND_I12NDFRAC_PAD_CONTROL=0, DPLL0_OCC_IMPLEMENTED=1, DPLL1_IMPLEMENTED=1, DPLL1_I12ND_I12NDFRAC_PAD_CONTROL=0, DPLL1_OCC_IMPLEMENTED=0, GCLK_ID_DFLL48=0, GCLK_ID_FDPLL0=1, GCLK_ID_FDPLL1=2, GCLK_ID_FDPLL032K=3, GCLK_ID_FDPLL132K=3, OSC16M_IMPLEMENTED=0, OSC48M_IMPLEMENTED=0, OSC48M_NUM=1, RCOSCS_NUM=1, XOSCS_NUM=2, XOSC0_CFD_CLK_SELECT_SIZE=4, XOSC0_CFD_IMPLEMENTED=1, XOSC0_IMPLEMENTED=1, XOSC0_ONDEMAND_RESET_VALUE=1, XOSC0_RUNSTDBY_RESET_VALUE=0, XOSC1_CFD_CLK_SELECT_SIZE=4, XOSC1_CFD_IMPLEMENTED=1, XOSC1_IMPLEMENTED=1, XOSC1_ONDEMAND_RESET_VALUE=1, XOSC1_RUNSTDBY_RESET_VALUE=0, DFLL48M_VERSION=0x100, FDPLL_VERSION=0x100, XOSC_VERSION=0x100, INSTANCE_ID=4
OSC32KCTRL at 0x40001400
  pins: XIN32 PA00/XIN32; XOUT32 PA01/XOUT32
  parameters: OSC32K_COARSE_CALIB_MSB=0, INSTANCE_ID=5
PAC at 0x40000000
  parameters: HPB_NUM=4, INSTANCE_ID=0
PCC at 0x43002C00
  pins: CLK PA14/K; DATA{n} PA{n+16}/K (n=0..7); DATA8 PB14/K; DATA9 PB15/K; DATA10 PC12/K; DATA11 PC13/K; DATA12 PC14/K; DATA13 PC15/K; DEN1 PA12/K; DEN2 PA13/K
  parameters: DATA_SIZE=14, DMAC_ID_RX=80, INSTANCE_ID=107
PDEC at 0x42001C00
  pins: QDI0 PB18/G or PB23/G or PC16/G or PA24/G; QDI1 PB19/G or PB24/G or PC17/G or PA25/G; QDI2 PB20/G or PB25/G or PC18/G or PB22/G
  parameters: CC_NUM=2, GCLK_ID=31, INSTANCE_ID=71
PM at 0x40000400
  pins: RESET_N RESET_N
  parameters: PD_NUM=0, INSTANCE_ID=1
PORT at 0x41008000
  pins: P{n} PA{n:02} (n=0..25); P27 PA27; P30 PA30; P31 PA31; P{n} PB{n-32:02} (n=32..63); P{n} PC{n-64:02} (n=64..71); P{n} PC{n-64} (n=74..92); P94 PC30; P95 PC31; P96 PD00; P97 PD01; P104 PD08; P105 PD09; P106 PD10; P107 PD11; P108 PD12; P116 PD20; P117 PD21
  parameters: BITS=118, DRVSTR=1, EV_NUM=4, GROUPS=4, ODRAIN=0, SLEWLIM=0, INSTANCE_ID=36
PUKCC
  parameters: RAM_ADDR_SIZE=12, ROM_ADDR_SIZE=16, INSTANCE_ID=76
QSPI at 0x42003400
  pins: CS PB11/H; DATA0 PA08/H; DATA1 PA09/H; DATA2 PA10/H; DATA3 PA11/H; SCK PB10/H
  parameters: DMAC_ID_RX=83, DMAC_ID_TX=84, HADDR_MSB=23, OCMS=1, INSTANCE_ID=77
RAMECC at 0x41020000
  parameters: RAMADDR_BITS=13, RAMBANK_NUM=4, INSTANCE_ID=48
RSTC at 0x40000C00
  parameters: BACKUP_IMPLEMENTED=1, HIB_IMPLEMENTED=1, NUMBER_OF_EXTWAKE=0, NVMRST_IMPLEMENTED=1, INSTANCE_ID=3
RTC at 0x40002400
  pins: IN0 PB00; IN1 PB02; IN2 PA02/RTC_IN_2; IN3 PC00; IN4 PC01; OUT PB01
  parameters: DMAC_ID_TIMESTAMP=1, GPR_NUM=4, NUM_OF_ALARMS=2, NUM_OF_BKREGS=8, NUM_OF_COMP16=4, NUM_OF_COMP32=2, NUM_OF_TAMPERS=5, PER_NUM=8, INSTANCE_ID=9
SDHC0 at 0x45000000 (SDHC)
  pins: SDCD PA06/I or PA12/I or PB12/I or PC06/I; SDCK PB11/I; SDCMD PA08/I; SDDAT0 PA09/I; SDDAT1 PA10/I; SDDAT2 PA11/I; SDDAT3 PB10/I; SDWP PA07/I or PA13/I or PB13/I or PC07/I
  parameters: CARD_DATA_SIZE=4, GCLK_ID=45, GCLK_ID_SLOW=3, NB_OF_DEVICES=1, NB_REG_PVR=8, NB_REG_RR=4
SDHC1 at 0x46000000 (SDHC)
  pins: SDCD PB16/I or PC20/I or PD20/I; SDCK PA21/I; SDCMD PA20/I; SDDAT0 PB18/I; SDDAT1 PB19/I; SDDAT2 PB20/I; SDDAT3 PB21/I; SDWP PB17/I or PC21/I or PD21/I
  parameters: CARD_DATA_SIZE=4, GCLK_ID=46, GCLK_ID_SLOW=3, NB_OF_DEVICES=1, NB_REG_PVR=8, NB_REG_RR=4
SERCOM0 at 0x40003000 (SERCOM)
  pins: PAD0 PA04/D or PC17/D or PA08/C or PB24/C; PAD1 PA05/D or PC16/D or PA09/C or PB25/C; PAD2 PA06/D or PC18/D or PA10/C or PC24/C; PAD3 PA07/D or PC19/D or PA11/C or PC25/C
  parameters: CLK_REDUCTION=1, DLY_COMPENSATION=1, DMA=1, DMAC_ID_RX=4, DMAC_ID_TX=5, FIFO_DEPTH_POWER=1, GCLK_ID_CORE=7, GCLK_ID_SLOW=3, INT_MSB=6, PMSB=3, RETENTION_SUPPORT=0, SE_CNT=1, SPI=1, SPI_HW_SS_CTRL=1, SPI_ICSPACE_EXT=1, SPI_OZMO=0, SPI_WAKE_ON_SSL=1, TTBIT_EXTENSION=1, TWIM=1, TWIS=1, TWIS_AUTO_ACK=1, TWIS_GROUP_CMD=1, TWIS_SDASETUP_CNT_SIZE=8, TWIS_SDASETUP_SIZE=4, TWIS_SUDAT=1, TWI_FASTMP=1, TWI_HSMODE=1, TWI_SCLSM_MODE=1, TWI_SMB_TIMEOUTS=1, TWI_TENBIT_ADR=1, USART=1, USART_AUTOBAUD=1, USART_COLDET=1, USART_FLOW_CTRL=1, USART_FRAC_BAUD=1, USART_IRDA=1, USART_ISO7816=1, USART_LIN_MASTER=1, USART_RS485=1, USART_SAMPA_EXT=1, USART_SAMPR_EXT=1, INSTANCE_ID=12
SERCOM1 at 0x40003400 (SERCOM)
  pins: PAD0 PA00/D or PA16/C or PC22/C or PC27/C; PAD1 PA01/D or PA17/C or PC23/C or PC28/C; PAD2 PA30/D or PA18/C or PB22/C or PD20/C; PAD3 PA31/D or PA19/C or PB23/C or PD21/C
  parameters: CLK_REDUCTION=1, DLY_COMPENSATION=1, DMA=1, DMAC_ID_RX=6, DMAC_ID_TX=7, FIFO_DEPTH_POWER=1, GCLK_ID_CORE=8, GCLK_ID_SLOW=3, INT_MSB=6, PMSB=3, RETENTION_SUPPORT=0, SE_CNT=1, SPI=1, SPI_HW_SS_CTRL=1, SPI_ICSPACE_EXT=1, SPI_OZMO=0, SPI_WAKE_ON_SSL=1, TTBIT_EXTENSION=1, TWIM=1, TWIS=1, TWIS_AUTO_ACK=1, TWIS_GROUP_CMD=1, TWIS_SDASETUP_CNT_SIZE=8, TWIS_SDASETUP_SIZE=4, TWIS_SUDAT=1, TWI_FASTMP=1, TWI_HSMODE=1, TWI_SCLSM_MODE=1, TWI_SMB_TIMEOUTS=1, TWI_TENBIT_ADR=1, USART=1, USART_AUTOBAUD=1, USART_COLDET=1, USART_FLOW_CTRL=1, USART_FRAC_BAUD=1, USART_IRDA=1, USART_ISO7816=1, USART_LIN_MASTER=1, USART_RS485=1, USART_SAMPA_EXT=1, USART_SAMPR_EXT=1, INSTANCE_ID=13
SERCOM2 at 0x41012000 (SERCOM)
  pins: PAD0 PA09/D or PB25/D or PA12/C or PB26/C; PAD1 PA08/D or PB24/D or PA13/C or PB27/C; PAD2 PA10/D or PC24/D or PB28/C or PA14/C; PAD3 PA11/D or PC25/D or PB29/C or PA15/C
  parameters: CLK_REDUCTION=1, DLY_COMPENSATION=1, DMA=1, DMAC_ID_RX=8, DMAC_ID_TX=9, FIFO_DEPTH_POWER=1, GCLK_ID_CORE=23, GCLK_ID_SLOW=3, INT_MSB=6, PMSB=3, RETENTION_SUPPORT=0, SE_CNT=1, SPI=1, SPI_HW_SS_CTRL=1, SPI_ICSPACE_EXT=1, SPI_OZMO=0, SPI_WAKE_ON_SSL=1, TTBIT_EXTENSION=1, TWIM=1, TWIS=1, TWIS_AUTO_ACK=1, TWIS_GROUP_CMD=1, TWIS_SDASETUP_CNT_SIZE=8, TWIS_SDASETUP_SIZE=4, TWIS_SUDAT=1, TWI_FASTMP=1, TWI_HSMODE=1, TWI_SCLSM_MODE=1, TWI_SMB_TIMEOUTS=1, TWI_TENBIT_ADR=1, USART=1, USART_AUTOBAUD=1, USART_COLDET=1, USART_FLOW_CTRL=1, USART_FRAC_BAUD=1, USART_IRDA=1, USART_ISO7816=1, USART_LIN_MASTER=1, USART_RS485=1, USART_SAMPA_EXT=1, USART_SAMPR_EXT=1, INSTANCE_ID=41
SERCOM3 at 0x41014000 (SERCOM)
  pins: PAD0 PA17/D or PC23/D or PA22/C or PB20/C; PAD1 PA16/D or PC22/D or PA23/C or PB21/C; PAD2 PA18/D or PA20/D or PD20/D or PA24/C; PAD3 PA19/D or PA21/D or PD21/D or PA25/C
  parameters: CLK_REDUCTION=1, DLY_COMPENSATION=1, DMA=1, DMAC_ID_RX=10, DMAC_ID_TX=11, FIFO_DEPTH_POWER=1, GCLK_ID_CORE=24, GCLK_ID_SLOW=3, INT_MSB=6, PMSB=3, RETENTION_SUPPORT=0, SE_CNT=1, SPI=1, SPI_HW_SS_CTRL=1, SPI_ICSPACE_EXT=1, SPI_OZMO=0, SPI_WAKE_ON_SSL=1, TTBIT_EXTENSION=1, TWIM=1, TWIS=1, TWIS_AUTO_ACK=1, TWIS_GROUP_CMD=1, TWIS_SDASETUP_CNT_SIZE=8, TWIS_SDASETUP_SIZE=4, TWIS_SUDAT=1, TWI_FASTMP=1, TWI_HSMODE=1, TWI_SCLSM_MODE=1, TWI_SMB_TIMEOUTS=1, TWI_TENBIT_ADR=1, USART=1, USART_AUTOBAUD=1, USART_COLDET=1, USART_FLOW_CTRL=1, USART_FRAC_BAUD=1, USART_IRDA=1, USART_ISO7816=1, USART_LIN_MASTER=1, USART_RS485=1, USART_SAMPA_EXT=1, USART_SAMPR_EXT=1, INSTANCE_ID=42
SERCOM4 at 0x43000000 (SERCOM)
  pins: PAD0 PA13/D or PB08/D or PB27/D or PB12/C; PAD1 PA12/D or PB09/D or PB26/D or PB13/C; PAD2 PA14/D or PB10/D or PB28/D or PB14/C; PAD3 PB11/D or PB29/D or PA15/D or PB15/C
  parameters: CLK_REDUCTION=1, DLY_COMPENSATION=1, DMA=1, DMAC_ID_RX=12, DMAC_ID_TX=13, FIFO_DEPTH_POWER=1, GCLK_ID_CORE=34, GCLK_ID_SLOW=3, INT_MSB=6, PMSB=3, RETENTION_SUPPORT=0, SE_CNT=1, SPI=1, SPI_HW_SS_CTRL=1, SPI_ICSPACE_EXT=1, SPI_OZMO=0, SPI_WAKE_ON_SSL=1, TTBIT_EXTENSION=1, TWIM=1, TWIS=1, TWIS_AUTO_ACK=1, TWIS_GROUP_CMD=1, TWIS_SDASETUP_CNT_SIZE=8, TWIS_SDASETUP_SIZE=4, TWIS_SUDAT=1, TWI_FASTMP=1, TWI_HSMODE=1, TWI_SCLSM_MODE=1, TWI_SMB_TIMEOUTS=1, TWI_TENBIT_ADR=1, USART=1, USART_AUTOBAUD=1, USART_COLDET=1, USART_FLOW_CTRL=1, USART_FRAC_BAUD=1, USART_IRDA=1, USART_ISO7816=1, USART_LIN_MASTER=1, USART_RS485=1, USART_SAMPA_EXT=1, USART_SAMPR_EXT=1, INSTANCE_ID=96
SERCOM5 at 0x43000400 (SERCOM)
  pins: PAD0 PA23/D or PB02/D or PB31/D or PB16/C; PAD1 PA22/D or PB03/D or PB30/D or PB17/C; PAD2 PA24/D or PB00/D or PB22/D or PA20/C or PB18/C; PAD3 PA25/D or PB01/D or PB23/D or PA21/C or PB19/C
  parameters: CLK_REDUCTION=1, DLY_COMPENSATION=1, DMA=1, DMAC_ID_RX=14, DMAC_ID_TX=15, FIFO_DEPTH_POWER=1, GCLK_ID_CORE=35, GCLK_ID_SLOW=3, INT_MSB=6, PMSB=3, RETENTION_SUPPORT=0, SE_CNT=1, SPI=1, SPI_HW_SS_CTRL=1, SPI_ICSPACE_EXT=1, SPI_OZMO=0, SPI_WAKE_ON_SSL=1, TTBIT_EXTENSION=1, TWIM=1, TWIS=1, TWIS_AUTO_ACK=1, TWIS_GROUP_CMD=1, TWIS_SDASETUP_CNT_SIZE=8, TWIS_SDASETUP_SIZE=4, TWIS_SUDAT=1, TWI_FASTMP=1, TWI_HSMODE=1, TWI_SCLSM_MODE=1, TWI_SMB_TIMEOUTS=1, TWI_TENBIT_ADR=1, USART=1, USART_AUTOBAUD=1, USART_COLDET=1, USART_FLOW_CTRL=1, USART_FRAC_BAUD=1, USART_IRDA=1, USART_ISO7816=1, USART_LIN_MASTER=1, USART_RS485=1, USART_SAMPA_EXT=1, USART_SAMPR_EXT=1, INSTANCE_ID=97
SERCOM6 at 0x43000800 (SERCOM)
  pins: PAD0 PD09/D or PC13/D or PC04/C or PC16/C; PAD1 PD08/D or PC12/D or PC05/C or PC17/C; PAD2 PC14/D or PD10/D or PC06/C or PC10/C or PC18/C; PAD3 PC15/D or PD11/D or PC07/C or PC11/C or PC19/C
  parameters: CLK_REDUCTION=1, DLY_COMPENSATION=1, DMA=1, DMAC_ID_RX=16, DMAC_ID_TX=17, FIFO_DEPTH_POWER=1, GCLK_ID_CORE=36, GCLK_ID_SLOW=3, INT_MSB=6, PMSB=3, RETENTION_SUPPORT=0, SE_CNT=1, SPI=1, SPI_HW_SS_CTRL=1, SPI_ICSPACE_EXT=1, SPI_OZMO=0, SPI_WAKE_ON_SSL=1, TTBIT_EXTENSION=1, TWIM=1, TWIS=1, TWIS_AUTO_ACK=1, TWIS_GROUP_CMD=1, TWIS_SDASETUP_CNT_SIZE=8, TWIS_SDASETUP_SIZE=4, TWIS_SUDAT=1, TWI_FASTMP=1, TWI_HSMODE=1, TWI_SCLSM_MODE=1, TWI_SMB_TIMEOUTS=1, TWI_TENBIT_ADR=1, USART=1, USART_AUTOBAUD=1, USART_COLDET=1, USART_FLOW_CTRL=1, USART_FRAC_BAUD=1, USART_IRDA=1, USART_ISO7816=1, USART_LIN_MASTER=1, USART_RS485=1, USART_SAMPA_EXT=1, USART_SAMPR_EXT=1, INSTANCE_ID=98
SERCOM7 at 0x43000C00 (SERCOM)
  pins: PAD0 PB21/D or PD08/C or PB30/C or PC12/C; PAD1 PB20/D or PD09/C or PB31/C or PC13/C; PAD2 PB18/D or PC10/D or PC14/C or PD10/C or PA30/C; PAD3 PB19/D or PC11/D or PC15/C or PD11/C or PA31/C
  parameters: CLK_REDUCTION=1, DLY_COMPENSATION=1, DMA=1, DMAC_ID_RX=18, DMAC_ID_TX=19, FIFO_DEPTH_POWER=1, GCLK_ID_CORE=37, GCLK_ID_SLOW=3, INT_MSB=6, PMSB=3, RETENTION_SUPPORT=0, SE_CNT=1, SPI=1, SPI_HW_SS_CTRL=1, SPI_ICSPACE_EXT=1, SPI_OZMO=0, SPI_WAKE_ON_SSL=1, TTBIT_EXTENSION=1, TWIM=1, TWIS=1, TWIS_AUTO_ACK=1, TWIS_GROUP_CMD=1, TWIS_SDASETUP_CNT_SIZE=8, TWIS_SDASETUP_SIZE=4, TWIS_SUDAT=1, TWI_FASTMP=1, TWI_HSMODE=1, TWI_SCLSM_MODE=1, TWI_SMB_TIMEOUTS=1, TWI_TENBIT_ADR=1, USART=1, USART_AUTOBAUD=1, USART_COLDET=1, USART_FLOW_CTRL=1, USART_FRAC_BAUD=1, USART_IRDA=1, USART_ISO7816=1, USART_LIN_MASTER=1, USART_RS485=1, USART_SAMPA_EXT=1, USART_SAMPR_EXT=1, INSTANCE_ID=99
SUPC at 0x40001800
  pins: OUT0 PB01; OUT1 PB02; VBAT PB03
  parameters: BOD12_CALIB_MSB=5, BOD33_CALIB_MSB=5, INSTANCE_ID=6
TAL at 0x4101E000
  pins: BRK PA27/H or PB31/H
  parameters: CPU_NUM=2, CTI_NUM=4, DMA_CH_NUM=32, EV_CH_NUM=12, EXTINT_NUM=16, ID_IN_INTCPUSEL=1, ID_NUM=130, INT_GRP_NUM=5, INT_NUM=137, INT_NUM_BITS=8, IPS_GRP_NUM=2, IPS_NUM=64, IRQMON_NUM=1, INSTANCE_ID=47
TC0 at 0x40003800 (TC)
  pins: WO0 PA04/E or PA08/E or PB30/E; WO1 PA05/E or PA09/E or PB31/E
  parameters: CC_NUM=2, DMAC_ID_OVF=44, EXT=0, GCLK_ID=9, MASTER_SLAVE_MODE=1, OW_NUM=2, INSTANCE_ID=14
TC1 at 0x40003C00 (TC)
  pins: WO0 PA06/E or PA10/E; WO1 PA07/E or PA11/E
  parameters: CC_NUM=2, DMAC_ID_OVF=47, EXT=0, GCLK_ID=9, MASTER_SLAVE_MODE=2, OW_NUM=2, INSTANCE_ID=15
TC2 at 0x4101A000 (TC)
  pins: WO0 PA12/E or PA16/E or PA00/E; WO1 PA01/E or PA13/E or PA17/E
  parameters: CC_NUM=2, DMAC_ID_OVF=50, EXT=0, GCLK_ID=26, MASTER_SLAVE_MODE=1, OW_NUM=2, INSTANCE_ID=45
TC3 at 0x4101C000 (TC)
  pins: WO0 PA18/E or PA14/E; WO1 PA15/E or PA19/E
  parameters: CC_NUM=2, DMAC_ID_OVF=53, EXT=0, GCLK_ID=26, MASTER_SLAVE_MODE=2, OW_NUM=2, INSTANCE_ID=46
TC4 at 0x42001400 (TC)
  pins: WO0 PA22/E or PB08/E or PB12/E; WO1 PA23/E or PB09/E or PB13/E
  parameters: CC_NUM=2, DMAC_ID_OVF=56, EXT=0, GCLK_ID=30, MASTER_SLAVE_MODE=1, OW_NUM=2, INSTANCE_ID=69
TC5 at 0x42001800 (TC)
  pins: WO0 PA24/E or PB10/E or PB14/E; WO1 PA25/E or PB11/E or PB15/E
  parameters: CC_NUM=2, DMAC_ID_OVF=59, EXT=0, GCLK_ID=30, MASTER_SLAVE_MODE=2, OW_NUM=2, INSTANCE_ID=70
TC6 at 0x43001400 (TC)
  pins: WO0 PA30/E or PB02/E or PB16/E; WO1 PA31/E or PB03/E or PB17/E
  parameters: CC_NUM=2, DMAC_ID_OVF=62, EXT=0, GCLK_ID=39, MASTER_SLAVE_MODE=1, OW_NUM=2, INSTANCE_ID=101
TC7 at 0x43001800 (TC)
  pins: WO0 PA20/E or PB00/E or PB22/E; WO1 PA21/E or PB01/E or PB23/E
  parameters: CC_NUM=2, DMAC_ID_OVF=65, EXT=0, GCLK_ID=39, MASTER_SLAVE_MODE=2, OW_NUM=2, INSTANCE_ID=102
TCC0 at 0x41016000 (TCC)
  pins: WO0 PA20/G or PB12/G or PA08/F or PC04/F or PC10/F or PC16/F; WO1 PA21/G or PB13/G or PA09/F or PC11/F or PC17/F or PD08/F; WO2 PA22/G or PB14/G or PA10/F or PC12/F or PC18/F or PD09/F; WO3 PA23/G or PB15/G or PA11/F or PC13/F or PC19/F or PD10/F; WO4 PA16/G or PB16/G or PB10/F or PC14/F or PC20/F or PD11/F; WO5 PA17/G or PB17/G or PB11/F or PC15/F or PC21/F or PD12/F; WO6 PA18/G or PB30/G or PA12/F or PC22/F; WO7 PA19/G or PB31/G or PA13/F or PC23/F
  parameters: CC_NUM=6, DITHERING=1, DMAC_ID_OVF=22, DTI=1, EXT=31, GCLK_ID=25, MASTER_SLAVE_MODE=1, OTMX=1, OW_NUM=8, PG=1, SIZE=24, SWAP=1, INSTANCE_ID=43
TCC1 at 0x41018000 (TCC)
  pins: WO0 PB10/G or PC14/G or PA16/F or PB18/F or PD20/F; WO1 PB11/G or PC15/G or PA17/F or PB19/F or PD21/F; WO2 PA12/G or PA14/G or PA18/F or PB20/F or PB26/F; WO3 PA13/G or PA15/G or PA19/F or PB21/F or PB27/F; WO4 PA08/G or PC10/G or PA20/F or PB28/F; WO5 PA09/G or PC11/G or PA21/F or PB29/F; WO6 PA10/G or PC12/G or PA22/F; WO7 PA11/G or PC13/G or PA23/F
  parameters: CC_NUM=4, DITHERING=1, DMAC_ID_OVF=29, DTI=1, EXT=31, GCLK_ID=25, MASTER_SLAVE_MODE=2, OTMX=1, OW_NUM=8, PG=1, SIZE=24, SWAP=1, INSTANCE_ID=44
TCC2 at 0x42000C00 (TCC)
  pins: WO0 PA14/F or PA30/F; WO1 PA15/F or PA31/F; WO2 PA24/F or PB02/F
  parameters: CC_NUM=3, DITHERING=0, DMAC_ID_OVF=34, DTI=0, EXT=1, GCLK_ID=29, MASTER_SLAVE_MODE=0, OTMX=1, OW_NUM=3, PG=0, SIZE=16, SWAP=0, INSTANCE_ID=67
TCC3 at 0x42001000 (TCC)
  pins: WO0 PB12/F or PB16/F; WO1 PB13/F or PB17/F
  parameters: CC_NUM=2, DITHERING=0, DMAC_ID_OVF=38, DTI=0, EXT=0, GCLK_ID=29, MASTER_SLAVE_MODE=0, OTMX=0, OW_NUM=2, PG=0, SIZE=16, SWAP=0, INSTANCE_ID=68
TCC4 at 0x43001000 (TCC)
  pins: WO0 PB14/F or PB30/F; WO1 PB15/F or PB31/F
  parameters: CC_NUM=2, DITHERING=0, DMAC_ID_OVF=41, DTI=0, EXT=0, GCLK_ID=38, MASTER_SLAVE_MODE=0, OTMX=0, OW_NUM=2, PG=0, SIZE=16, SWAP=0, INSTANCE_ID=100
TRNG at 0x42002800
  parameters: INSTANCE_ID=74
USB at 0x41000000
  pins: DM PA24/H; DP PA25/H; SOF_1KHZ PA23/H or PB22/H
  parameters: AHB_2_USB_FIFO_DEPTH=4, AHB_2_USB_RD_DATA_BITS=8, AHB_2_USB_WR_DATA_BITS=32, AHB_2_USB_WR_THRESHOLD=2, DATA_BUS_16_8=0, EPNUM=8, EPT_NUM=8, GCLK_ID=10, INITIAL_CONTROL_QOS=3, INITIAL_DATA_QOS=3, MISSING_SOF_DET_IMPLEMENTED=1, PIPE_NUM=8, SYSTEM_CLOCK_IS_CKUSB=0, USB_2_AHB_FIFO_DEPTH=4, USB_2_AHB_RD_DATA_BITS=16, USB_2_AHB_RD_THRESHOLD=2, USB_2_AHB_WR_DATA_BITS=8, INSTANCE_ID=32
WDT at 0x40002000
  parameters: INSTANCE_ID=8
SystemControl at 0xE000E000
SysTick at 0xE000E010
NVIC at 0xE000E100
MPU at 0xE000ED90

## Interrupts
-14 NonMaskableInt — Non Maskable Interrupt
-13 HardFault — Cortex-M4 Hard Fault Interrupt
-12 MemoryManagement — Cortex-M4 Memory Management Interrupt
-11 BusFault — Cortex-M4 Bus Fault Interrupt
-10 UsageFault — Cortex-M4 Usage Fault Interrupt
-5 SVCall — Cortex-M4 SV Call Interrupt
-4 DebugMonitor — Cortex-M4 Debug Monitor Interrupt
-2 PendSV — Cortex-M4 Pend SV Interrupt
-1 SysTick — Cortex-M4 System Tick Interrupt
0 PM
1 MCLK
2 OSCCTRL_XOSC0 (OSCCTRL)
3 OSCCTRL_XOSC1 (OSCCTRL)
4 OSCCTRL_DFLL (OSCCTRL)
5 OSCCTRL_DPLL0 (OSCCTRL)
6 OSCCTRL_DPLL1 (OSCCTRL)
7 OSC32KCTRL
8 SUPC_OTHER (SUPC)
9 SUPC_BODDET (SUPC)
10 WDT
11 RTC
{n+12} EIC_EXTINT_{n} (EIC) (n=0..15)
28 FREQM
29 NVMCTRL_0 (NVMCTRL)
30 NVMCTRL_1 (NVMCTRL)
31 DMAC_0 (DMAC)
32 DMAC_1 (DMAC)
33 DMAC_2 (DMAC)
34 DMAC_3 (DMAC)
35 DMAC_OTHER (DMAC)
36 EVSYS_0 (EVSYS)
37 EVSYS_1 (EVSYS)
38 EVSYS_2 (EVSYS)
39 EVSYS_3 (EVSYS)
40 EVSYS_OTHER (EVSYS)
41 PAC
42 TAL_BRK (TAL)
43 TAL_IPS (TAL)
45 RAMECC
{4n+46} SERCOM{n}_0 (SERCOM{n}) (n=0..7)
{4n+47} SERCOM{n}_1 (SERCOM{n}) (n=0..7)
{4n+48} SERCOM{n}_2 (SERCOM{n}) (n=0..7)
{4n+49} SERCOM{n}_OTHER (SERCOM{n}) (n=0..7)
80 USB_OTHER (USB)
81 USB_SOF_HSOF (USB)
82 USB_TRCPT0 (USB)
83 USB_TRCPT1 (USB)
85 TCC0_OTHER (TCC0)
86 TCC0_MC0 (TCC0)
87 TCC0_MC1 (TCC0)
88 TCC0_MC2 (TCC0)
89 TCC0_MC3 (TCC0)
90 TCC0_MC4 (TCC0)
91 TCC0_MC5 (TCC0)
92 TCC1_OTHER (TCC1)
93 TCC1_MC0 (TCC1)
94 TCC1_MC1 (TCC1)
95 TCC1_MC2 (TCC1)
96 TCC1_MC3 (TCC1)
97 TCC2_OTHER (TCC2)
98 TCC2_MC0 (TCC2)
99 TCC2_MC1 (TCC2)
100 TCC2_MC2 (TCC2)
101 TCC3_OTHER (TCC3)
102 TCC3_MC0 (TCC3)
103 TCC3_MC1 (TCC3)
104 TCC4_OTHER (TCC4)
105 TCC4_MC0 (TCC4)
106 TCC4_MC1 (TCC4)
{n+107} TC{n} (n=0..7)
115 PDEC_OTHER (PDEC)
116 PDEC_MC0 (PDEC)
117 PDEC_MC1 (PDEC)
118 ADC0_OTHER (ADC0)
119 ADC0_RESRDY (ADC0)
120 ADC1_OTHER (ADC1)
121 ADC1_RESRDY (ADC1)
122 AC
123 DAC_OTHER (DAC)
124 DAC_EMPTY_0 (DAC)
125 DAC_EMPTY_1 (DAC)
126 DAC_RESRDY_0 (DAC)
127 DAC_RESRDY_1 (DAC)
128 I2S
129 PCC
130 AES
131 TRNG
132 ICM
133 PUKCC
134 QSPI
135 SDHC0
136 SDHC1

## Properties
SIGNATURES: DSU_DID=0x60060000

## Pinouts (pin number, pad)
SAMD51P: 1 PA00, 2 PA01, 3 PC00, 4 PC01, 6 VDDANA, 7 PC02, 8 PC03, 9 PA02, 10 PA03, 11 PB04, 12 PB05, 13 PD00, 14 GNDANA, 15 VDDANA, 16 PD01, 17 PB06, 18 PB07, 19 PB08, 20 PB09, 21 PA04, 22 PA05, 23 PA06, 24 PA07, 25 GNDANA, 26 VDDANA, 27 PC04, 28 PC05, 29 PC06, 30 PC07, 31 GND, 32 VDDIO, 33 PA08, 34 PA09, 35 PA10, 36 PA11, 37 VDDIO, 38 GND, 39 PB10, 40 PB11, 41 PB12, 42 PB13, 43 PB14, 44 PB15, 45 GND, 46 VDDIO, 47 PD08, 48 PD09, 49 PD10, 50 PD11, 51 PD12, 52 PC10, 53 GND, 54 VDDIO, 55 PC11, 56 PC12, 57 PC13, 58 PC14, 59 PC15, 60 PA12, 61 PA13, 62 PA14, 63 PA15, 64 GND, 65 VDDIO, 66 PA16, 67 PA17, 68 PA18, 69 PA19, 70 PC16, 71 PC17, 72 PC18, 73 PC19, 74 PC20, 75 PC21, 76 PC22, 77 PC23, 78 GND, 79 VDDIO, 80 PD20, 81 PD21, 82 PB16, 83 PB17, 84 PB18, 85 PB19, 86 PB20, 87 PB21, 88 PA20, 89 PA21, 90 GND, 91 VDDIO, 92 PA22, 93 PA23, 94 PA24, 95 PA25, 96 GND, 97 VDDIO, 98 PB22, 99 PB23, 100 PB24, 101 PB25, 102 PB26, 103 PB27, 104 PB28, 105 PB29, 106 GND, 107 VDDIO, 108 PC24, 109 PC25, 110 PC26, 111 PC27, 112 PC28, 113 PA27, 114 RESET_N, 115 VDDCORE, 116 GND, 117 VSW, 118 VDDIO, 119 PA30, 120 PA31, 121 PB30, 122 PB31, 123 PC30, 124 PC31, 125 PB00, 126 PB01, 127 PB02, 128 PB03

## Notices in the file
Copyright (c) 2017 Microchip Technology Inc.
SPDX-License-Identifier: Apache-2.0
Licensed under the Apache License, Version 2.0 (the "License"); you may
not use this file except in compliance with the License.
You may obtain a copy of the Licence at
http://www.apache.org/licenses/LICENSE-2.0
Unless required by applicable law or agreed to in writing, software
distributed under the License is distributed on an AS IS BASIS, WITHOUT
WARRANTIES OR CONDITIONS OF ANY KIND, either express or implied.
See the License for the specific language governing permissions and
limitations under the License.
